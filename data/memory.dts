/dts-v1/;

/ {
    #address-cells = <1>;
    #size-cells = <1>;
    compatible = "ucbbar,spike-bare-dev";
    model = "spike";

    memory@0 {
        device_type = "memory";
        reg = <0x00000000 0x00020000>; /* 128 KB RAM starting at 0x0 */
    };

    cpus {
        #address-cells = <1>;
        #size-cells = <0>;
        timebase-frequency = <10000000>;

        CPU0: cpu@0 {
            device_type = "cpu";
            reg = <0>;
            status = "okay";
            compatible = "riscv";
            riscv,isa = "rv32i";
        };
    };
};

